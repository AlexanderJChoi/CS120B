/* Name & E-mail: Alexander Choi, achoi035@ucr.edu
 *	Lab Section: 26
 *	Assignment: Final Project
 *	
 *	I acknowledge all content contained herein, excluding template or example
 *	code, is my own original work.
 */

#include <avr/io.h>
#include "nokia5110.h"
#include "nokia5110.c"
#include <avr/interrupt.h>
#include "bit.h"
#include "timer.h"
#include "keypad.h"
#include "io.c"
#include <stdio.h>

#define RESET_Button (~PINA&0x01)
#define SCREEN_HEIGHT 48
#define SCREEN_WIDTH 84
#define MAZE_SIZE 158

unsigned char maze[] = {0xff, 0xff, 0xff, 0xff, 0xff, 0xff, 0xff, 0xff, 0xff, 0xff, 0xff, 0xff, 0xff, 0xff, 0xff, 0xff, 0xff, 0xff, 0xff, 0xfc,
	0xff, 0xff, 0xff, 0xff, 0xff, 0xff, 0xff, 0xff, 0xff, 0xff, 0xff, 0xff, 0xff, 0xff, 0xff, 0xff, 0xff, 0xff, 0xff, 0xfc,
	0xc0, 0x00, 0x00, 0x00, 0x00, 0x00, 0x00, 0x18, 0x00, 0x00, 0x18, 0x01, 0x80, 0x00, 0x00, 0x00, 0x00, 0x00, 0x00, 0x0c,
	0xc0, 0x00, 0x00, 0x00, 0x00, 0x00, 0x00, 0x18, 0x00, 0x00, 0x18, 0x01, 0x80, 0x00, 0x00, 0x00, 0x00, 0x00, 0x00, 0x0c,
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0xff, 0xff, 0xff, 0xff, 0xff, 0xff, 0xff, 0xff, 0xff, 0xff, 0xff, 0xff, 0xff, 0xff, 0xff, 0xff, 0xff, 0xff, 0xff, 0xfc};

unsigned char character[] = {0xF8, 0xF8, 0xF8, 0xF8, 0xF8};

void LCD_drawImage(unsigned char * image, short pos_x, short pos_y, uint8_t size_x, uint8_t size_y) {
	
	uint8_t line_size = (size_x % 8 == 0) ? (size_x / 8) : (size_x / 8) + 1;
	uint8_t row, col;
	unsigned char bit;
	unsigned short tempX, tempY, tempI;
	
	for (row = (pos_y < 0) ? (pos_y * -1) : 0; row < size_y; row++) {
		tempY = pos_y + row;
		if((tempY < SCREEN_HEIGHT)) {
			for (col = (pos_x < 0) ? (pos_x * -1 / 8) : 0; col < line_size; col++ ) {
				tempI = row * line_size + col;
				for (bit = 0; bit < 8; bit++) {
					tempX = pos_x + (col * 8) + ( 7 - bit );
					if ( ((image[tempI] & (1 << bit))) && (tempX < SCREEN_WIDTH)) {
						nokia_lcd_set_pixel(tempX, tempY, 1);
					}
				}
			}
		} else {
			break;
		}
	}
}

//--------Find GCD function --------------------------------------------------
unsigned long int findGCD(unsigned long int a, unsigned long int b)
{
	unsigned long int c;
	while(1){
		c = a%b;
		if(c==0){return b;}
		a = b;
b = c;
	}
	return 0;
}
//--------End find GCD function ----------------------------------------------

//--------Task scheduler data structure---------------------------------------
// Struct for Tasks represent a running process in our simple real-time operating system.
typedef struct _task {
	/*Tasks should have members that include: state, period,
		a measurement of elapsed time, and a function pointer.*/
	signed char state; //Task's current state
	unsigned long int period; //Task period
	unsigned long int elapsedTime; //Time elapsed since last task tick
	int (*TickFct)(int); //Task tick function
} task;

//--------End Task scheduler data structure-----------------------------------

//--------Shared Variables----------------------------------------------------
short offset_x = 0, offset_y = 0;
short player_x = 10, player_y = 10;
unsigned char score = 0;
unsigned char playing = 0;

//--------End Shared Variables------------------------------------------------

//--------User defined FSMs---------------------------------------------------
//Enumeration of states.
enum LCD_update_states {render};
	
int LCD_updateTick(int state) {
	switch(state) {
		default:
		state = render;
	}
	
	switch(state) {
		case render:
		nokia_lcd_render();
		nokia_lcd_clear();
	}
	return state;
}

enum Game_checkstart_states {reset_off, reset_pressed};
	
int Game_checkstartTick(int state) {
	unsigned char reset = RESET_Button;
	
	switch(state) { //state transitions
		case reset_off:
			if(reset) {
				state = reset_pressed;
				if (playing == 0) {
					playing = 1;
				} else {
					playing = 0;
				}
			} else {
				state = reset_off;
			}
		default:
			if(reset) {
				state = reset_pressed;
				} else {
				state = reset_off;
			}
	}
	
	//no state actions
	
	return state;
}

enum Draw_Maze_states {drawMaze, notDrawMaze};
	
int Draw_MazeTick(int state) {
	switch(state) {
		default:
			if(playing) {
				state = drawMaze;
			} else {
				state = notDrawMaze;
			}
			break;
	}
	
	switch(state) {
		case drawMaze:
			LCD_drawImage(&(maze[0]), 0 - offset_x, 0 - offset_y, MAZE_SIZE, MAZE_SIZE);
			break;
		default:
			//do nothing
			break;
	}
	return state;
}


enum Draw_Player_states {drawPlayer, notDrawPlayer};

int Draw_PlayerTick(int state) {
	switch(state) {
		default:
		if(playing) {
			state = drawPlayer;
			} else {
			state = notDrawPlayer;
		}
		break;
	}
	
	switch(state) {
		case drawPlayer:
		LCD_drawImage(&(character[0]), player_x - offset_x, player_y - offset_y, 5, 5);
		break;
		default:
		//do nothing
		break;
	}
	return state;
}

enum Change_Offset_states {Offset_Traverse_down, Offset_Traverse_right, Offset_Traverse_up, Offset_Traverse_left};

int Change_OffsetTick(int state) {
	switch(state) {
		case Offset_Traverse_down:
			if(playing) {
				if(offset_y >= MAZE_SIZE - SCREEN_HEIGHT) {
					state = Offset_Traverse_right;
				} else {
					state = Offset_Traverse_down;
				}
			} else {
				state = Offset_Traverse_down;
			}
			break;
		case Offset_Traverse_right:
			if(playing) {
				if(offset_x >= MAZE_SIZE - SCREEN_WIDTH) {
					state = Offset_Traverse_up;
				} else {
					state = Offset_Traverse_right;
				}
			} else {
				state = Offset_Traverse_up;
			}
			break;
		case Offset_Traverse_up:
			if(playing) {
				if(offset_y <= 0) {
					state = Offset_Traverse_left;
				} else {
					state = Offset_Traverse_up;
				}
			} else {
				state = Offset_Traverse_up;
			}
			break;
		case Offset_Traverse_left:
			if(playing) {
				if(offset_x < 0) {
					state = Offset_Traverse_down;
				} else {
					state = Offset_Traverse_left;
				}
			} else {
				state = Offset_Traverse_left;
			}
			break;
		default:
			state = Offset_Traverse_down;
	}
	
	switch(state) {
		case Offset_Traverse_down:
			if(playing) {
				offset_y ++;
			}
			break;
		case Offset_Traverse_right:
			if(playing) {
				offset_x ++;
			}
			break;
		case Offset_Traverse_up:
			if(playing) {
				offset_y--;
			}
			break;
		case Offset_Traverse_left:
			if(playing) {
				offset_x--;
			}
			break;
	}
	
	return state;
}


// --------END User defined FSMs-----------------------------------------------

// Implement scheduler code from PES.
int main()
{
// Set Data Direction Registers
DDRA = 0x00; PORTA = 0xFF;

// Period for the tasks
unsigned long int LCD_update_calc = 10;
unsigned long int Game_checkstart_calc = 10;
unsigned long int Draw_Maze_calc = 10;
unsigned long int Draw_Player_calc = 10;

unsigned long int Change_Offset_calc = 10;


//Calculating GCD
unsigned long int tmpGCD = 1;
tmpGCD = findGCD(LCD_update_calc, Game_checkstart_calc);
tmpGCD = findGCD(tmpGCD, Draw_Maze_calc);
tmpGCD = findGCD(tmpGCD, Draw_Player_calc);
tmpGCD = findGCD(tmpGCD, Change_Offset_calc);

//Greatest common divisor for all tasks or smallest time unit for tasks.
unsigned long int GCD = tmpGCD;

//Recalculate GCD periods for scheduler
unsigned long int LCD_update_period = LCD_update_calc/GCD;
unsigned long int Game_checkstart_period = Game_checkstart_calc/GCD;
unsigned long int Draw_Maze_period = Draw_Maze_calc/GCD;
unsigned long int Draw_Player_period = Draw_Player_calc/GCD;
unsigned long int Change_Offset_period = Change_Offset_calc/GCD;

//Declare an array of tasks (NOTE: everything which makes an image should be BEFORE the LCD_u) 
//i.e. Draw order: Maze -> coins -> player -> render
static task LCD_u, Game_checkstart, Draw_Maze, Draw_Player, Change_Offset;
task *tasks[] = {&Change_Offset, &Draw_Maze, &Draw_Player, &LCD_u, &Game_checkstart};
const unsigned short numTasks = sizeof(tasks)/sizeof(task*);

// LCD
LCD_u.state = -1;//Task initial state.
LCD_u.period = LCD_update_period;//Task Period.
LCD_u.elapsedTime = LCD_update_period;//Task current elapsed time.
LCD_u.TickFct = &LCD_updateTick;//Function pointer for the tick.
// Game CheckStart
Game_checkstart.state = -1;//Task initial state.
Game_checkstart.period = Game_checkstart_period;//Task Period.
Game_checkstart.elapsedTime = Game_checkstart_period;//Task current elapsed time.
Game_checkstart.TickFct = &Game_checkstartTick;//Function pointer for the tick.
// Draw Maze
Draw_Maze.state = -1;//Task initial state.
Draw_Maze.period = Draw_Maze_period;//Task Period.
Draw_Maze.elapsedTime = Draw_Maze_period;//Task current elapsed time.
Draw_Maze.TickFct = &Draw_MazeTick;//Function pointer for the tick.
// Draw Player
Draw_Player.state = -1;//Task initial state.
Draw_Player.period = Draw_Player_period;//Task Period.
Draw_Player.elapsedTime = Draw_Player_period;//Task current elapsed time.
Draw_Player.TickFct = &Draw_PlayerTick;//Function pointer for the tick.
// Change Offset
Change_Offset.state = -1;//Task initial state.
Change_Offset.period = Change_Offset_period;//Task Period.
Change_Offset.elapsedTime = Change_Offset_period;//Task current elapsed time.
Change_Offset.TickFct = &Change_OffsetTick;//Function pointer for the tick.

//initialize nokia LCD screen
nokia_lcd_init();

// Set the timer and turn it on
TimerSet(GCD);
TimerOn();

unsigned short i; // Scheduler for-loop iterator
while(1) {
	// Scheduler code
	for ( i = 0; i < numTasks; i++ ) {
		// Task is ready to tick
		if ( tasks[i]->elapsedTime == tasks[i]->period ) {
			// Setting next state for task
			tasks[i]->state = tasks[i]->TickFct(tasks[i]->state);
			// Reset the elapsed time for next tick.
			tasks[i]->elapsedTime = 0;
		}
		tasks[i]->elapsedTime += 1;
	}
	while(!TimerFlag) ;
	TimerFlag = 0;
}

// Error: Program should not exit!
return 0;
}
